#include <Arduino.h>
#include <NeoPixelBus.h>
#include <SPI.h>
#include <Wire.h>
#include <Adafruit_GFX.h>
#include <Adafruit_SSD1306.h>
#include <Keyboard.h>

#define SCREEN_WIDTH 128    // OLED display width, in pixels
#define SCREEN_HEIGHT 64    // OLED display height, in pixels
#define SCREEN_ADDRESS 0x3c ///< See datasheet for Address; 0x3D for 128x64, 0x3C for 128x32

#define LED_PIN 6
#define BTN_PIN 12

NeoPixelBus<NeoGrbFeature, Neo800KbpsMethod>
    ledStrip(1, LED_PIN);

#define OLED_RESET -1 // Reset pin # (or -1 if sharing Arduino reset pin)

Adafruit_SSD1306 display(SCREEN_WIDTH, SCREEN_HEIGHT, &Wire, OLED_RESET);

#define LOGO_HEIGHT 16
#define LOGO_WIDTH 16

#define NUMFLAKES 5
#define XPOS 0 // Indexes into the 'icons' array in function below
#define YPOS 1
#define DELTAY 2

int8_t icons[NUMFLAKES][3];
int8_t animationIdx = 0;

#define FRAMES 6
static const unsigned char PROGMEM animation[6][512] = {{0b00000000, 0b00000000, 0b00000000, 0b00000000, 0b00000000, 0b00000000, 0b00000000, 0b00000000, 0b00000000, 0b00000000, 0b00000000, 0b00000000, 0b00000000,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 0b00000000, 0b00000000}, {0b00000000, 0b00000000, 0b00000000, 0b00000000, 0b00000000, 0b00000000, 0b00000000, 0b00000000, 0b00000000, 0b00000000, 0b00000000, 0b00000000, 0b00000000,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 0b00000000, 0b00000000}, {0b00000000, 0b00000000, 0b00000000, 0b00000000, 0b00000000, 0b00000000, 0b00000000, 0b00000000, 0b00000000, 0b00000000, 0b00000000, 0b00000000, 0b00000000,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 0b00000000, 0b00000000}, {0b00000000, 0b00000000, 0b00000000, 0b00000000, 0b00000000, 0b00000000, 0b00000000, 0b00000000, 0b00000000, 0b00000000, 0b00000000, 0b00000000, 0b00000000,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 0b00000000, 0b00000000}, {0b00000000, 0b00000000, 0b00000000, 0b00000000, 0b00000000, 0b00000000, 0b00000000, 0b00000000, 0b00000000, 0b00000000, 0b00000000, 0b00000000, 0b00000000,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 0b00000000, 0b00000000}, {0b00000000, 0b00000000, 0b00000000, 0b00000000, 0b00000000, 0b00000000, 0b00000000, 0b00000000, 0b00000000, 0b00000000, 0b00000000, 0b00000000, 0b00000000,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 0b00000000, 0b00000000}};

static struct image_s
{
  uint16_t x;
  uint16_t y;
  uint16_t width;
  uint16_t height;
  uint8_t *data;
} img =
    {
        .x = 0,
        .y = 0,
        .width = 0,
        .height = 0,
        .data = NULL};

static struct keys_s
{
  uint8_t n;
  uint8_t *keys;
} keys =
    {
        .n = 0,
        .keys = NULL};

#define DEFAULT_TIMEOUT 200

void setup()
{
  Serial.begin(115200);
  Serial.setTimeout(DEFAULT_TIMEOUT);

  Keyboard.begin();

  pinMode(BTN_PIN, INPUT);

  if (!display.begin(SSD1306_SWITCHCAPVCC, SCREEN_ADDRESS))
  {
    Serial.println(F("SSD1306 allocation failed"));
    for (;;)
      ; // Don't proceed, loop forever
  }

  display.setRotation(2);

  display.clearDisplay();

  display.display();
}

void serialReset()
{
  // Empty buffer
  while (Serial.available())
  {
    Serial.read();
  }

  Serial.end();
  Serial.setTimeout(DEFAULT_TIMEOUT);
  Serial.begin(115200);
}

#define SLEEP_PERIOD_MS 10

int serialRead(void *buf, size_t size, unsigned timeout = 0)
{
  if (Serial.readBytes((uint8_t *)buf, size) != size)
  {
    return -1;
  }
  else
  {
    return 0;
  }
#if 0
  unsigned start = millis();
  size_t total = 0;

  while ((total < size) && ((millis() - start < timeout) || (timeout == 0)))
  {
    size_t available = Serial.available();

    if (available)
    {
      int read_now = Serial.readBytes((uint8_t *)buf + total,
                                      available > size ? size : available);
      total += read_now;
    }
    else
    {
      delay(SLEEP_PERIOD_MS);
    }
  }

  if (total == size)
  {
    return 0;
  }
  else
  {
    return -1;
  }
#endif
}

int serialWrite(void *buf, size_t size)
{
  if (Serial.write((uint8_t *)buf, size) != size)
  {
    return -1;
  }
  else
  {
    Serial.flush();
    return 0;
  }
}

#define CHUNK_SIZE 16

int serialReadAck(void *buf, size_t size, unsigned timeout)
{
  int err = -1;
  uint8_t ack = 0x42;

  if (serialRead(buf, size, timeout) < 0)
  {
    goto error;
  }

  // Send ACK
  if (serialWrite(&ack, sizeof(uint8_t)) < 0)
  {
    goto error;
  }

  err = 0;
error:
  return err;
}

#define MAGIC 0x4242

enum config_msg_type_e
{
  MSG_TYPE_IMAGE = 0,
  MSG_TYPE_KEYS = 1,
  MSG_TYPE_RESET = 2
};

int handleImage()
{
  int err = -1;
  uint16_t datasize;
  size_t total_read = 0;

  // Read x coord
  if (serialRead(&img.x, sizeof(uint16_t), DEFAULT_TIMEOUT) < 0)
  {
    goto error;
  }

  // Read y coord
  if (serialRead(&img.y, sizeof(uint16_t), DEFAULT_TIMEOUT) < 0)
  {
    goto error;
  }

  // Read width
  if (serialRead(&img.width, sizeof(uint16_t), DEFAULT_TIMEOUT) < 0)
  {
    goto error;
  }

  // Read height
  if (serialRead(&img.height, sizeof(uint16_t), DEFAULT_TIMEOUT) < 0)
  {
    goto error;
  }

  // Read data length
  if (serialRead(&datasize, sizeof(uint16_t), DEFAULT_TIMEOUT) < 0)
  {
    goto error;
  }

  // Free previous image memory
  if (img.data)
  {
    free(img.data);
  }

  // Allocate data
  if ((img.data = (uint8_t *)malloc(datasize)) == NULL)
  {
    goto error;
  }

  while (total_read < datasize)
  {
    size_t readsize = ((datasize - total_read) < CHUNK_SIZE) ? (datasize - total_read) : CHUNK_SIZE;

    if (serialReadAck(img.data + total_read, readsize, DEFAULT_TIMEOUT) < 0)
    {
      goto error;
    }

    total_read += readsize;
  }

  // Clear the display buffer
  display.clearDisplay();

  // Finallly, draw the image
  display.drawBitmap(img.x, img.y, img.data, img.width, img.height, SSD1306_WHITE);

  display.display();

  err = 0;
error:
  return err;
}

int handleKeys()
{
  int err = -1;

  // Read x coord
  if (serialRead(&keys.n, sizeof(uint8_t), DEFAULT_TIMEOUT) < 0)
  {
    goto error;
  }

  if (keys.keys)
  {
    free(keys.keys);
  }

  if ((keys.keys = (uint8_t *)malloc(sizeof(uint8_t) * keys.n)) == NULL)
  {
    goto error;
  }

  if (serialRead(keys.keys, sizeof(uint8_t) * keys.n, DEFAULT_TIMEOUT) < 0)
  {
    goto error;
  }

  err = 0;
error:
  return err;
}

int handleConfig()
{
  int err = -1;

  // First, read code
  uint16_t magic;
  uint8_t type;

  // Receive magic first
  if (serialRead(&magic, sizeof(uint16_t), DEFAULT_TIMEOUT) < 0)
  {
    ledStrip.SetPixelColor(0, RgbColor(128, 128, 0));
    ledStrip.Show();
    delay(1000);
    goto error;
  }

  if (magic != MAGIC)
  {
    ledStrip.SetPixelColor(0, RgbColor(128, 0, 128));
    ledStrip.Show();
    delay(1000);
    goto error;
  }

  // Send magic back for ACK
  if (serialWrite(&magic, sizeof(uint16_t)) < 0)
  {
    goto error;
  }
another:
  // Get message type
  if (serialRead(&type, sizeof(uint8_t), DEFAULT_TIMEOUT) < 0)
  {
    goto error;
  }

  switch (type)
  {
  case MSG_TYPE_IMAGE:
  {
    if (handleImage() < 0)
    {
      goto error;
    }

    break;
  }

  case MSG_TYPE_KEYS:
  {
    if (handleKeys() < 0)
    {
      goto error;
    }

    break;
  }

  case MSG_TYPE_RESET:
  {
    if (img.data)
    {
      free(img.data);
      img.data = NULL;
    }

    if (keys.keys)
    {
      keys.n = 0;
      free(keys.keys);
      keys.keys = NULL;
    }
  }

  default:
  {
    goto error;
  }
  }

  if (Serial.available())
  {
    goto another;
  }

  err = 0;
  goto done;

error:
  ledStrip.SetPixelColor(0, RgbColor(128, 0, 0));
  ledStrip.Show();
  // delay(1000);

  goto ret;

done:
  ledStrip.SetPixelColor(0, RgbColor(0, 0, 128));
  ledStrip.Show();
  // delay(1000);

ret:
  serialReset();
  return err;
}

void loop()
{
  // Configuration logic
  if (Serial.available())
  {
    handleConfig();
  }

  // Button press logic
  if (digitalRead(BTN_PIN) == 1)
  {
    ledStrip.SetPixelColor(0, RgbColor(128, 128, 128));
    ledStrip.Show();
  }
  else
  {
    int i;
    ledStrip.SetPixelColor(0, RgbColor(0, 255, 0));
    ledStrip.Show();

    // Press all keys
    for (i = 0; i < keys.n; ++i)
    {
      Keyboard.press(keys.keys[i]);
      delay(10);
    }

    delay(100);
    Keyboard.releaseAll();
  }

  // Loop forever...
  display.clearDisplay(); // Clear the display buffer

  if (img.data != NULL)
  {
    display.drawBitmap(img.x, img.y + (animationIdx % 2) * 5, img.data, img.width, img.height, SSD1306_WHITE);
  }
  else
  {
    display.drawBitmap(30, -15, animation[animationIdx], 64, 64, SSD1306_WHITE);
  }

  animationIdx = (animationIdx + 1) % FRAMES;

  display.display(); // Show the display buffer on the screen
  delay(200);        // Pause for 1/10 second
}